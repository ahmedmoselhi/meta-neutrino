## conf/layer.conf
```bitbake
LAYERSERIES_COMPAT_neutrino-mp = "zeus dunfell"

# We have a conf and classes directory, append to BBPATH
BBPATH .= ":${LAYERDIR}"

# We have a recipes directory containing .bb and .bbappend files, add to BBFILES
BBFILES := "${BBFILES} ${LAYERDIR}/recipes*/*/*.bb \ 
            ${LAYERDIR}/recipes*/*/*.bbappend"

BBFILE_COLLECTIONS += "neutrino-mp"
BBFILE_PATTERN_neutrino-mp := "^${LAYERDIR}/"
BBFILE_PRIORITY_neutrino-mp = "6"

# Additional license directories.
LICENSE_PATH += "${LAYERDIR}/files/custom-licenses"
```
